## oasis/lichee/linux-3.4/drivers/sounder/Kconfig
```kconfig
#
#  sounder power amp deviced.
#

menuconfig  SOUNDER_DEVICE
	tristate "--- sounder DSP and power-amp devices --- "
	default n
	help
	  say Y here, when you have a i2c device want to be enable and test.
	  when  unsure , Say N.

if SOUNDER_DEVICE

source "drivers/sounder/ntp8230/Kconfig"
source "drivers/sounder/npca110/Kconfig"

endif
```

## oasis/lichee/linux-3.4/drivers/sounder/npca110/Kconfig
```kconfig
#
#  sounder DSP deviced.
#


config  NPCA110_I2C_DIV
	tristate "--- NPCA110 sounder DSP deal for sounder device --- "
	default n
	help
	  say Y here, when you have a i2c device want to be enable and test.
	  when  unsure , Say N.
```

## oasis/lichee/linux-3.4/drivers/sounder/ntp8230/Kconfig
```kconfig
#
#  sounder power amp deviced.
#


config  NTP8230_I2C_DIV
	tristate "--- NTP8230 power amp driver for sounder device --- "
	default n
	help
	  say Y here, when you have a i2c device want to be enable and test.
	  when  unsure , Say N.
```
